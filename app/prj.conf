## CMakeLists.txt
```
cmake_minimum_required(VERSION 3.20.0)

find_package(Zephyr REQUIRED HINTS $ENV{ZEPHYR_BASE})
project(app)

# Find and link the micro_ros_zephyr_module
find_package(micro_ros_zephyr_module REQUIRED)

target_sources(app PRIVATE src/main.c)

target_link_libraries(app PRIVATE micro_ros_zephyr_module)
```

## prj.conf
```kconfig
# Micro-ROS configuration
CONFIG_MICRO_ROS=y
CONFIG_MICRO_ROS_APP_STACK_SIZE=4096

# Serial/UART Console configuration
CONFIG_CONSOLE=y
CONFIG_UART_CONSOLE=y
CONFIG_USB_DEVICE_STACK=y
CONFIG_USB_DEVICE_PRODUCT="Zephyr"
CONFIG_USB_DEVICE_VID=2fe3
CONFIG_USB_DEVICE_PID=0100
CONFIG_USB_DEVICE_MANUFACTURER="Zephyr"
CONFIG_USB_CDC_ACM=y
CONFIG_UART_LINE_CTRL=y


# Heap and memory configuration
CONFIG_HEAP_MEM_POOL_SIZE=8192
CONFIG_MAIN_STACK_SIZE=4096

# Enable C++ support for Micro-ROS
CONFIG_CPLUSPLUS=y
CONFIG_LIB_CPLUSPLUS=y

# SENSOR
CONFIG_GPIO=y
CONFIG_I2C=y
CONFIG_SPI=y

# Other configurations
CONFIG_ASSERT=y
CONFIG_PRINTK=y
```

## src/main.c
```c
#include <zephyr.h>
#include <stdio.h>
#include <rcl/rcl.h>
#include <rclc/rclc.h>
#include <rclc/executor.h>
#include <std_msgs/msg/int32.h>
#include <rmw_microros/rmw_microros.h>
#include "microros_transports.h"

#define RCCHECK(fn) { rcl_ret_t temp_rc = fn; if((temp_rc != RCL_RET_OK)){printf("Failed status on line %d: %d. Aborting.\n",__LINE__,(int)temp_rc);for(;;){};}}
#define RCSOFTCHECK(fn) { rcl_ret_t temp_rc = fn; if((temp_rc != RCL_RET_OK)){printf("Failed status on line %d: %d. Continuing.\n",__LINE__,(int)temp_rc);}}

rcl_publisher_t publisher;
std_msgs__msg__Int32 msg;

void timer_callback(rcl_timer_t * timer, int64_t last_call_time)
{
	(void) last_call_time;
	if (timer != NULL) {
		RCSOFTCHECK(rcl_publish(&publisher, &msg, NULL));
		msg.data++;
	}
}

void main(void)
{
	// Set custom transport
	rmw_uros_set_custom_transport(
		true,
		NULL,
		zephyr_transport_open,
		zephyr_transport_close,
		zephyr_transport_write,
		zephyr_transport_read
	);

	// Micro-ROS App
	rcl_allocator_t allocator = rcl_get_default_allocator();
	rclc_support_t support;

	// create init_options
	RCCHECK(rclc_support_init(&support, 0, NULL, &allocator));

	// create node
	rcl_node_t node;
	RCCHECK(rclc_node_init_default(&node, "stm32_node", "", &support));

	// create publisher
	RCCHECK(rclc_publisher_init_default(
		&publisher,
		&node,
		ROSIDL_GET_MSG_TYPE_SUPPORT(std_msgs, msg, Int32),
		"micro_ros_counter"));

	// create timer,
	rcl_timer_t timer;
	const unsigned int timer_timeout = 1000;
	RCCHECK(rclc_timer_init_default(
		&timer,
		&support,
		RCL_MS_TO_NS(timer_timeout),
		timer_callback));

	// create executor
	rclc_executor_t executor;
	RCCHECK(rclc_executor_init(&executor, &support.context, 1, &allocator));
	RCCHECK(rclc_executor_add_timer(&executor, &timer));

	msg.data = 0;

	while(1){
		rclc_executor_spin_some(&executor, RCL_MS_TO_NS(100));
		k_sleep(K_MSEC(100));
	}
}
```
