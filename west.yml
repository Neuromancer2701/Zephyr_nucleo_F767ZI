## west.yml
```yaml
manifest:
  remotes:
    - name: zephyrproject-rtos
      url-base: https://github.com/zephyrproject-rtos
    - name: micro-ROS
      url-base: https://github.com/micro-ROS
  projects:
    - name: zephyr
      remote: zephyrproject-rtos
      revision: main
      import: true
    - name: micro_ros_zephyr_module
      remote: micro-ROS
      revision: main
      path: modules/lib/micro_ros_zephyr_module
  self:
    path: app
```
